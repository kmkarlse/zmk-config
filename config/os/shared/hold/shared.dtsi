hm: homerow_mods {
    compatible = "zmk,behavior-hold-tap";
    #binding-cells = <2>;
    tapping-term-ms = <HR_TAPPING>;
    quick-tap-ms = <HR_QUICK_TAP>;
    flavor = HR_FLAVOR;
    bindings = <&kp>, <&kp>;
};

tokp: to_kp {
    compatible = "zmk,behavior-hold-tap";
    #binding-cells = <2>;
    tapping-term-ms = <HP_TAPPING>;
    flavor = "hold-preferred";
    bindings = <&to>, <&kp>;
};

moto: mo_to {
    compatible = "zmk,behavior-hold-tap";
    #binding-cells = <2>;
    tapping-term-ms = <HP_TAPPING>;
    flavor = "hold-preferred";
    bindings = <&mo>, <&to>;
};
