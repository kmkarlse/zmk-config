TO_MACRO(w, DEV)  //to_wDEV
TO_MACRO(w, AXN)  //to_wAXN
TO_MACRO(w, FNK)  //to_wFNK
TO_MACRO(w, STG)  //to_wSTG

MOTO_MACRO(w, AXN, BAS)  //mo_wAXN_to_wBAS
MOTO_MACRO(w, AXN, DEV)  //mo_wAXN_to_wDEV
MOTO_MACRO(w, STG, BAS)  //mo_wSTG_to_wBAS
MOTO_MACRO(w, DEV, BAS)  //mo_wDEV_to_wBAS
MOTO_MACRO(w, FNK, AXN)  //mo_wFNK_to_wAXN

cw_wCAPS: cw_wCAPS {
    compatible = "zmk,behavior-macro";
    #binding-cells = <0>;
    tap-ms = <MC_TAP>;
    bindings
        = <&kp LS(H_wCWR)>
        , <&kp CAPS>;
};

cw_wON: cw_wON {
    compatible = "zmk,behavior-macro";
    #binding-cells = <0>;
    bindings
        = <&kp LA(H_wCWR)>
        , <&cw>;
};

cw_wOFF: cw_wOFF {
    compatible = "zmk,behavior-macro";
    #binding-cells = <0>;
    bindings
        = <&kp LS(LC(H_wCWR))>
        , <&kp K_CANCEL>;
};